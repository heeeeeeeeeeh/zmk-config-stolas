## config/west.yml
```yaml
manifest:
  defaults:
    revision: v0.3
  remotes:
    - name: zmkfirmware
      url-base: https://github.com/zmkfirmware
    # Additional modules containing boards/shields/custom code can be listed here as well
    # See https://docs.zephyrproject.org/3.2.0/develop/west/manifest.html#projects
    - name: heeeeeeeeeeh
      url-base: https://github.com/heeeeeeeeeeh/
    - name: caksoylar # <-- new entry
      url-base: https://github.com/caksoylar
  projects:
    - name: zmk
      remote: zmkfirmware
      import: app/west.yml
    - name: zmk-keyboard-stolas
      remote: heeeeeeeeeeh
      revision: main
    - name: zmk-rgbled-widget # <-- new entry
      remote: caksoylar
      revision: main
  self:
    path: config
```
